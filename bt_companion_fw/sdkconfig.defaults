## firmware/components/audio_convert/Kconfig
```kconfig
menu "Audio conversion (audio_convert)"

config AUDIO_CONVERT_MP3
    bool "Support MP3 uploads (vendors minimp3)"
    default n
    help
        Lets Settings -> Operator / Dial Codes accept .mp3 uploads directly
        from the browser, decoded on-device via minimp3 (CC0) before going
        through the same 8kHz-mono conversion as WAV uploads. WAV upload
        works either way; MP3 sources also always work via the host-side
        sync_pi_audio.py/gen_prompt.py --from song.mp3 workflow regardless
        of this option.

        Measured costs of turning this on (your own board -- rebuild and
        compare if you want exact numbers):
          - Flash: modest, ~23KB (minimp3 itself is small).
          - RAM: NOT modest. minimp3's mp3dec_decode_frame() declares a
            ~16KB local (its internal decode scratch buffers) -- confirmed
            via a live "Stack protection fault" panic + addr2line, not a
            guess. The web UI's httpd task stack has to be sized well past
            that single local (32KB total, up from 8KB otherwise) to
            avoid crashing on every MP3 upload, and that's a permanent
            cost of the one always-running httpd worker task, not
            something paid only during an upload. On a chip with ~342KB
            total usable RAM, that's the real tradeoff to weigh, not the
            flash number.

endmenu
```

## firmware/components/board/Kconfig
```kconfig
menu "Board configuration"

choice
    prompt "Target board type"
    default BOARD_TYPE_SMD4
    help
        Select the pin map for the hardware variant. All supported boards
        use the ES8388 codec.

config BOARD_TYPE_SMD2
    bool "SMD2 gateway (ES8388, ESP32-C6-WROOM-1 pin map)"

config BOARD_TYPE_SMD4
    bool "SMD4 gateway (ES8388, ESP32-C6-DevKitC-1 pin map)"
    help
        Analog Redial v4, the current board -- see docs/hardware-smd4.md
        and archive/hardware/smd4.md. A different GPIO map from SMD2: the
        MCU is an ESP32-C6-DevKitC-1 carrier rather than a soldered
        WROOM-1 module.

config BOARD_TYPE_SMD5
    bool "SMD5 gateway, real Espressif module (ES8388, ESP32-C6-DevKitC-1 pin map, native USB)"
    help
        Analog Redial v5 -- see archive/hardware/smd5.md. Same pin map as
        SMD4, plus the BM64 companion's MFB on GPIO15. Use this for either
        MCU module as long as the JP2/JP3 jumpers match the module.

config BOARD_TYPE_SMD5_CHEAP
    bool "SMD5 gateway, AliExpress clone module (ES8388, ESP32-C6-DevKitC-1 pin map, no native USB)"
    help
        Only for an SMD5 with the clone module whose JP2/JP3 jumpers were
        left at the default: MCLK and card-detect then land on the clone's
        GPIO12/13 (its native USB pins), so this build remaps them, detaches
        the USB PHY, and puts the console on UART0 (sdkconfig.smd5_cheap
        .defaults). See archive/hardware/smd5.md.

endchoice

endmenu
```

## firmware/components/player/Kconfig
```kconfig
menu "Player configuration"

config PLAYER_MP3
    bool "Support MP3 playback (dial-code clips, prompts)"
    default n
    help
        Lets player_play() stream-decode MP3 files (vendors minimp3, same
        decoder audio_convert's upload-time CONFIG_AUDIO_CONVERT_MP3 option
        uses -- turning either one on compiles it in) instead of requiring
        everything to be raw PCM WAV. The point is storage: a full-length
        song at a low mono bitrate (e.g. 32kbps) is 3-4x smaller than the
        same audio as 8kHz/16-bit PCM WAV, which matters on a device with a
        few MB of flash for all its clips/recordings combined. See
        firmware/bringup/gen_prompt.py's --name *.mp3 handling for the
        host-side encode half of this.

        Deliberately a SEPARATE option from CONFIG_AUDIO_CONVERT_MP3 rather
        than reusing it, even though both compile the same decoder: that
        option's RAM cost is a PERMANENT one (its own Kconfig help explains
        why -- the httpd worker task, which runs for the device's entire
        uptime, needs a much bigger stack to survive minimp3's ~16KB decode
        local). This option's cost is instead paid only by player.c's own
        task, and only while something is actually playing (its stack is
        freed again afterward) -- a real but much cheaper and temporary
        tradeoff, not something you pay for just by having WiFi up. Turning
        this on with the upload option OFF gets MP3 PLAYBACK without also
        paying for MP3 BROWSER UPLOADS you may not need (gen_prompt.py's
        host-side pipeline uploads pre-encoded files through the plain
        byte-for-byte /media/<name> endpoint either way, upload option or
        not).

endmenu
```

## firmware/components/storage/Kconfig
```kconfig
menu "Storage configuration"

config STORAGE_RECORDING_CAP_BYTES
    int "Recording storage cap (bytes)"
    default 4194304
    help
        Soft cap enforced by the storage component on top of internal flash
        (the "storage" SPIFFS partition is 6MB total per partitions.csv, but
        that's shared with future prompt/clip assets -- this 4MB default
        leaves ~2MB of headroom on the partition for those. Oldest files are
        deleted automatically to stay under this cap when a new one is
        written. Not used once a microSD backend exists -- SD capacity is
        used as-is.

endmenu
```

## firmware/components/wifi/Kconfig
```kconfig
menu "WiFi configuration"

config WIFI_SSID
    string "Default WiFi SSID"
    default ""
    help
        Fallback used only if no credentials have been saved via the
        'wifi_set <ssid> <password>' console command (NVS always wins once
        set). Leave blank to require the console command instead.

config WIFI_PASSWORD
    string "Default WiFi password"
    default ""
    help
        See CONFIG_WIFI_SSID. Stored in plaintext in the built binary like
        any other Kconfig string -- fine for a bring-up default, but prefer
        the console command for anything you don't want sitting in flash.

config MDNS_HOSTNAME
    string "mDNS hostname (reachable as <hostname>.local)"
    default "phone"
    help
        Advertised over mDNS once WiFi is up -- resolvable as e.g.
        "phone.local" from macOS/iOS (native Bonjour), Linux (needs avahi,
        usually already installed), and Windows 10+ (native) or older
        Windows with Bonjour Print Services installed.

endmenu
```
